## openwrt/package/allwinner/display/libuapi/Config.in
```kconfig
if PACKAGE_libuapi

choice
prompt "Choose display framework"
	default SUNXI_DISPLAY_TWO
	help
	Select the preferred minigui running mode.
config SUNXI_DISPLAY_ONE
	bool "sunxi_display1"
config SUNXI_DISPLAY_TWO
	bool "sunxi_display2"
endchoice
choice
prompt "Choose alloc method"
	default SUNXI_ALLOC_IOMMU
	help
	Select how to apply for memory.
config SUNXI_ALLOC_CMA
	bool "sunxi_alloc_cma"
config SUNXI_ALLOC_IOMMU
	bool "sunxi_alloc_iommu"
endchoice
choice
prompt "Choose layer alloc method"
	default LUAPI_LAYER_ALLOC_CHN
	help
	Select how to apply for layer.
config LUAPI_LAYER_ALLOC_CHN
	bool "luapi_layer_alloc_chn"
config LUAPI_LAYER_ALLOC_LAY
	bool "luapi_layer_alloc_lay"
endchoice
choice
prompt "Choose display rendering mode"
	default SUNXI_DISPLAY_DE
	help
		Choose display rendering mode, DE or GPU.
config SUNXI_DISPLAY_DE
	bool "DE"
config SUNXI_DISPLAY_GPU
	bool "GPU"
	help
	Define the macro SUNXI_DISPLAY_GPU, use GPU rendering, send the RGBA data
	after rendering to fb1 display, execute export FRAMEBUFFER=/dev/fb1
	before executing the program, no longer support DispSetEnable, DispSetSrcRect,
	DispSetZorder and DispSetIoctl functions.

	Define the macro SUNXI_DISPLAY_GPU and SUNXI_DISPLAY_GPU_BUF, use GPU rendering,
	send the RGBA data after rendering to layer. No longer support DispSetSrcRect functions.
	Default use.
endchoice

endif
```

## openwrt/package/allwinner/security/optee-os-dev-kit/Config.in
```kconfig
if PACKAGE_optee-os-dev-kit

config OPTEE_ENCRYPT_TA
        bool "whether encrypt ta"
        default n

choice
	prompt "encrypt ta with which key"
	default OPTEE_ENCRYPT_TA_SSK_KEY
	depends on OPTEE_ENCRYPT_TA
	help
	  Select the block size of the root filesystem.

	config OPTEE_ENCRYPT_TA_SSK_KEY
	        bool "ssk"

	config OPTEE_ENCRYPT_TA_RTOPK_DERIVE_KEY
	        bool "key derive from rotpk"
endchoice

endif
```

## openwrt/package/allwinner/testtools/tinatest/config/base/bt/Config.in
```kconfig
menuconfig TINATEST_BASE_BT
    bool "bt"

if TINATEST_BASE_BT
    source "base_func/Config.in"
endif
```

## openwrt/package/allwinner/testtools/tinatest/config/base/bt/base_func/Config.in
```kconfig
menuconfig TINATEST_BASE_BT_BASE_FUNC
    bool "base_func"

if TINATEST_BASE_BT_BASE_FUNC
    source "bt_on_basefunc/Config.in"
    source "bt_off_basefunc/Config.in"
endif
```

## openwrt/package/allwinner/testtools/tinatest/config/base/display/Config.in
```kconfig
menuconfig TINATEST_BASE_DISPLAY
    bool "display"

if TINATEST_BASE_DISPLAY
    source "displyiftester/Config.in"
    source "capturetester/Config.in"
    source "fbshottester/Config.in"
    source "directfbtester/Config.in"
    source "tslibtester/Config.in"
    source "tplayertester/Config.in"
    source "g2d_bld_dmabuftester/Config.in"
    source "g2d_fill_dmabuftester/Config.in"
    source "g2d_lbc_rottester/Config.in"
    source "g2d_mixer_tasktester/Config.in"
endif
```

## openwrt/package/allwinner/testtools/tinatest/config/base/wifi/Config.in
```kconfig
menuconfig TINATEST_BASE_WIFI
    bool "wifi"

if TINATEST_BASE_WIFI
    source "base_func/Config.in"
endif
```

## openwrt/package/allwinner/testtools/tinatest/config/base/wifi/base_func/Config.in
```kconfig
menuconfig TINATEST_BASE_WIFI_BASE_FUNC
    bool "base_func"

if TINATEST_BASE_WIFI_BASE_FUNC
    source "station_mode/Config.in"
endif
```

## openwrt/package/allwinner/testtools/tinatest/config/base/wifi/base_func/station_mode/Config.in
```kconfig
menuconfig TINATEST_BASE_WIFI_BASE_FUNC_STATION_MODE
    bool "station_mode"

if TINATEST_BASE_WIFI_BASE_FUNC_STATION_MODE
    source "wifi_scan_basefunc/Config.in"
    source "wifi_connect_basefunc/Config.in"
    source "wifi_get-rssi_basefunc/Config.in"
    source "wifi_mac_basefunc/Config.in"
    source "wifi_remove_basefunc/Config.in"
    source "wifi_remove-all_basefunc/Config.in"
endif
```

## openwrt/package/allwinner/testtools/tinatest/config/stress/cpu/Config.in
```kconfig
menuconfig TINATEST_STRESS_CPU
    bool "cpu"

if TINATEST_STRESS_CPU
    source "cpucalc/Config.in"
    source "cpuhotplug/Config.in"
    source "cpufreq/Config.in"
endif
```

## openwrt/package/allwinner/testtools/tinatest/config/sys/global/info/language/Config.in
```kconfig
menuconfig TINATEST_SYS_GLOBAL_INFO_LANG
    bool "language"
    default n

if TINATEST_SYS_GLOBAL_INFO_LANG
choice
prompt "TinaTest Language"
	default TINATEST_SYS_GLOBAL_INFO_LANG_EN
	help
		Choose tinatest language.

config TINATEST_SYS_GLOBAL_INFO_LANG_EN
	bool "English"

config TINATEST_SYS_GLOBAL_INFO_LANG_ZH
	bool "Chiness"

endchoice
endif
```

## openwrt/package/allwinner/wireless/wifimanager/Config.in
```kconfig
config WMG_PROTOCOL_SOFTAP
	bool "CONFIG_WMG_PROTOCOL_SOFTAP"
	depends on PACKAGE_wifimanager-demo
	default n
	help
		softap net config.

config WMG_PROTOCOL_BLE
	bool "CONFIG_WMG_PROTOCOL_BLE"
	depends on PACKAGE_wifimanager-demo
	select PACKAGE_btmanager
	default n
	help
		ble net config.

config WMG_PROTOCOL_XCONFIG
	bool "CONFIG_WMG_PROTOCOL_XCONFIG"
	depends on PACKAGE_wifimanager-demo
	default n
	help
		xconfig net config.

config WMG_PROTOCOL_SOUNDWAVE
	bool "CONFIG_WMG_PROTOCOL_SOUNDWAVE"
	depends on PACKAGE_wifimanager-demo
	default n
	help
		soundwave net config.
```

## openwrt/package/feeds/libs/tslib/Config.in
```kconfig
if PACKAGE_tslib

config TSLIB_ENABLE_input
	bool "Generic input raw module"
	default y
	help
		Building for generic input raw module (Linux /dev/input/eventN)

config TSLIB_ENABLE_debounce
	bool "Debounce filter module"
	default n
	help
		Building of debounce filter

config TSLIB_ENABLE_dejitter
	bool "Dejitter filter module"
	default y
	help
		Building of dejitter filter

config TSLIB_ENABLE_iir
	bool "IIR filter module"
	default n
	help
		Building of IIR filter

config TSLIB_ENABLE_linear
	bool "Linear scaling module"
	default y
	help
		Building of linear scaling

config TSLIB_ENABLE_median
	bool "Median filter module"
	default n
	help
		Building of median filter

config TSLIB_ENABLE_pthres
	bool "Pthres filter module"
	default y
	help
		Building of pthres filter

config TSLIB_ENABLE_skip
	bool "Skip filter module"
	default n
	help
		Building of skip filter

config TSLIB_ENABLE_lowpass
	bool "Lowpass filter module"
	default n
	help
		Building of lowpass filter

config TSLIB_ENABLE_invert
	bool "Invert filter module"
	default n
	help
		Building of invert filter

config TSLIB_ENABLE_variance
	bool "Variance filter module"
	default y
	help
		Building of variance filter

config TSLIB_ENABLE_tatung
	bool "Tatung filter module"
	default n
	help
		Building of tatung raw module (Tatung Webpad support)

config TSLIB_ENABLE_touchkit
	bool "Touchkit filter module"
	default n
	help
		Building of serial TouchKit raw module (Linux /dev/ttySX support)

config TSLIB_ENABLE_waveshare
	bool "Waveshare filter module"
	default n
	help
		Building of WaveShare raw module (Linux /dev/hidrawN support)

config TSLIB_ENABLE_ucb1x00
	bool "Ucb1x00 filter module"
	default n
	help
		Building of ucb1x00 raw module (UCB1x00 support)

config TSLIB_ENABLE_mk712
	bool "Mk712 filter module"
	default n
	help
		Building of mk712 raw module (Hi tachi support)

config TSLIB_ENABLE_h3600
	bool "H3600 filter module"
	default n
	help
		Building of h3600 raw module (HP iPaq H3600 support)

config TSLIB_ENABLE_dmc
	bool "Dmc filter module"
	default n
	help
		Building of dmc raw module (HP iPaq DMC support)

config TSLIB_ENABLE_linear-h2200
	bool "Liner-h2200 filter module"
	default n
	help
		Building of linearizing filter for iPAQ h2200

config TSLIB_ENABLE_corgi
	bool "Corgi filter module"
	default n
	help
		Building of corgi raw module (Sharp Zaurus sl-c7x0 support)

config TSLIB_ENABLE_collie
	bool "Collie raw module"
	default n
	help
		Building of collie raw module (Sharp Zaurus sl-5500/5000d support)

config TSLIB_ENABLE_arctic2
	bool "Arctic2 raw module"
	default n
	help
	Building of arctic2 raw module (IBM Arctic II support)

config TSLIB_ENABLE_dmc_dus3000
	bool "Dmc_dus3000 raw module"
	default n
	help
		Building of dmc_dus3000 raw module (DMC DUS Series support)

config TSLIB_ENABLE_cy8mrln-palmpre
	bool "cy8mrln-palmpre"
	default n
	help
		Building of cy8mrln-palmpre raw module

config TSLIB_ENABLE_galax
	bool "Galax raw module"
	default n
	help
		Building of HID USB eGalax raw module (Linux /dev/hiddevN support)

config TSLIB_ENABLE_tests
	bool "Compiling tests program"
	default n
	help
		Select it to compile the tests program for tslib

config TSLIB_ENABLE_tools
	bool "Tools program (ts_uinput)"
	default n
	help
		Wheter enable the tools

endif
```
